## meta-vpn-gateway/conf/layer.conf
```bitbake
BBPATH .= ":${LAYERDIR}"

# We have recipes-* directories, add to BBFILES
BBFILES += "${LAYERDIR}/recipes-*/*/*.bb \
            ${LAYERDIR}/recipes-*/*/*.bbappend"

BBFILE_COLLECTIONS += "vpn-gateway"
BBFILE_PATTERN_vpn-gateway = "^${LAYERDIR}/"

LAYERDEPENDS_vpn-gateway = "core"
LAYERSERIES_COMPAT_vpn-gateway = "honister"
#BBFILE_PRIORITY_vpn-gateway = "{priority}"
```
